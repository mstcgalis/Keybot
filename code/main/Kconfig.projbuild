## code/main/Kconfig.projbuild
```kconfig
menu "SNTP Configuration"

    config SNTP_TIME_SERVER
        string "SNTP server name"
        default "pool.ntp.org"
        help
            Hostname of the main SNTP server.

    choice SNTP_TIME_SYNC_METHOD
        prompt "Time synchronization method"
        default SNTP_TIME_SYNC_METHOD_IMMED
        help
            Time synchronization method.

        config SNTP_TIME_SYNC_METHOD_IMMED
            bool "update time immediately when received"
    endchoice

endmenu

menu "WIFI Configuration"

    config EXAMPLE_WIFI_SSID
        string "WiFi SSID"
        default "myssid"
        help
            SSID (network name) for the example to connect to.

    config EXAMPLE_WIFI_PASSWORD
        string "WiFi Password"
        default "mypassword"
        help
            WiFi password (WPA or WPA2) for the example to use.

    config EXAMPLE_WIFI_LISTEN_INTERVAL
        int "WiFi listen interval"
        default 3
        help
            Interval for station to listen to beacon from AP. The unit of listen interval is one beacon interval.
            For example, if beacon interval is 100 ms and listen interval is 3, the interval for station to listen
            to beacon is 300 ms.

    choice EXAMPLE_POWER_SAVE_MODE
        prompt "power save mode"
        default EXAMPLE_POWER_SAVE_MIN_MODEM
        help
            Power save mode for the esp32 to use. Modem sleep mode includes minimum and maximum power save modes.
            In minimum power save mode, station wakes up every DTIM to receive beacon. Broadcast data will not be
            lost because it is transmitted after DTIM. However, it can not save much more power if DTIM is short
            for DTIM is determined by AP.
            In maximum power save mode, station wakes up every listen interval to receive beacon. Broadcast data
            may be lost because station may be in sleep state at DTIM time. If listen interval is longer, more power
            is saved but broadcast data is more easy to lose.

        config EXAMPLE_POWER_SAVE_NONE
            bool "none"
        config EXAMPLE_POWER_SAVE_MIN_MODEM
            bool "minimum modem"
        config EXAMPLE_POWER_SAVE_MAX_MODEM
            bool "maximum modem"
    endchoice

    choice EXAMPLE_MAX_CPU_FREQ
        prompt "Maximum CPU frequency"
        default EXAMPLE_MAX_CPU_FREQ_80
        depends on PM_ENABLE
        help
            Maximum CPU frequency to use for dynamic frequency scaling.

        config EXAMPLE_MAX_CPU_FREQ_80
            bool "80 MHz"
        config EXAMPLE_MAX_CPU_FREQ_160
            bool "160 MHz"
        config EXAMPLE_MAX_CPU_FREQ_240
            bool "240 MHz"
            depends on IDF_TARGET_ESP32 || IDF_TARGET_ESP32S2 || IDF_TARGET_ESP32S3
    endchoice

    config EXAMPLE_MAX_CPU_FREQ_MHZ
        int
        default 80 if EXAMPLE_MAX_CPU_FREQ_80
        default 160 if EXAMPLE_MAX_CPU_FREQ_160
        default 240 if EXAMPLE_MAX_CPU_FREQ_240


    choice EXAMPLE_MIN_CPU_FREQ
        prompt "Minimum CPU frequency"
        default EXAMPLE_MIN_CPU_FREQ_10M
        depends on PM_ENABLE
        help
            Minimum CPU frequency to use for dynamic frequency scaling.
            Should be set to XTAL frequency or XTAL frequency divided by integer.

        config EXAMPLE_MIN_CPU_FREQ_40M
            bool "40 MHz (use with 40MHz XTAL)"
            depends on !IDF_TARGET_ESP32 || ESP32_XTAL_FREQ_40 || ESP32_XTAL_FREQ_AUTO
        config EXAMPLE_MIN_CPU_FREQ_20M
            bool "20 MHz (use with 40MHz XTAL)"
            depends on !IDF_TARGET_ESP32 || ESP32_XTAL_FREQ_40 || ESP32_XTAL_FREQ_AUTO
        config EXAMPLE_MIN_CPU_FREQ_10M
            bool "10 MHz (use with 40MHz XTAL)"
            depends on !IDF_TARGET_ESP32 || ESP32_XTAL_FREQ_40 || ESP32_XTAL_FREQ_AUTO
        config EXAMPLE_MIN_CPU_FREQ_26M
            bool "26 MHz (use with 26MHz XTAL)"
            depends on ESP32_XTAL_FREQ_26 || ESP32_XTAL_FREQ_AUTO
        config EXAMPLE_MIN_CPU_FREQ_13M
            bool "13 MHz (use with 26MHz XTAL)"
            depends on ESP32_XTAL_FREQ_26 || ESP32_XTAL_FREQ_AUTO
    endchoice

    config EXAMPLE_MIN_CPU_FREQ_MHZ
        int
        default 40 if EXAMPLE_MIN_CPU_FREQ_40M
        default 20 if EXAMPLE_MIN_CPU_FREQ_20M
        default 10 if EXAMPLE_MIN_CPU_FREQ_10M
        default 26 if EXAMPLE_MIN_CPU_FREQ_26M
        default 13 if EXAMPLE_MIN_CPU_FREQ_13M

endmenu

menu "Capacitive Sensor"

    config TOUCH_PAD_NUM
        int "Touch Pad Number"
        default 4
        help
            GPIO pin number used for capacitive sensor.
    
    config TOUCH_PAD_THRESHOLD
        int "Touch Pad Threshold"
        default 410
        help
            Touch pad threshold used for capacitive sensor.
    
    config TOUCH_PAD_TIME_PERIOD
        int "Touch Pad Time Period (s)"
        default 1
        help
            Touch pad time period (in seconds) for which the sensor has to be engaged to change the key state.

endmenu

menu "Solenoid Knocking"

    config SOLENOID_GPIO
        int "Solenoid GPIO"
        range 0 48
        default 12
        help
            GPIO pin number used for solenoid knocking.

    config SOLENOID_DELAY_MS
        int "Solenoid Delay (ms)"
        default 500
        help
            Delay (in milliseconds) between two knocks.
    
    config SOLENOID_KNOCK_COUNT
        int "Solenoid Knocks Count"
        default 2
        help
            Number of time the solenoid will engaged in a single "knock".
    
    config SOLENOID_KNOCK_TIME_S
        int "Solenoid Knock Time (s)"
        default 10
        help
            Time (in seconds) for which "knocks" will be repreated on a sigle command.

endmenu

menu "LED Strip"
    
    config LED_GPIO
        int "LED GPIO"
        range 0 48
        default 25
        help
            GPIO pin number used for LED strip.

    config LED_COUNT
        int "LED Count"
        default 1
        help
            Number of LEDs in the strip.

    config LED_RMT_RES_HZ
        int "LED RMT Resolution (Hz)"
        default 10000000
        help
            RMT resolution (in Hz) for LED strip.
    
    config LED_VISIBILITY_TIME_S
        int "LED Visibility Time (s)"
        default 10
        help
            Time (in seconds) for which the visiblity (white) LED will stay on.

endmenu

menu "Discord"

    config DISCORD_CHANNEL_ID
        string "Discord Channel ID"
        default "0"
        help
            Discord channel ID in which the bot will read and send messages.

endmenu
```
